## Sesame/monolake/cb_monolake.defconfig
```kconfig
CONFIG_LOCALVERSION="OSF_OCP_MONOLAKE"
CONFIG_USE_BLOBS=y
CONFIG_VENDOR_OCP=y
CONFIG_FSP_FILE="site-local/monolake/fsp/BROADWELLDE_FSP.bin"
CONFIG_ENABLE_FSP_FAST_BOOT=y
CONFIG_FSP_PACKAGE_DEFAULT=y
CONFIG_MAINBOARD_SERIAL_NUMBER="Query BMC"
CONFIG_IFD_BIN_PATH="site-local/monolake/monolake_fd.bin"
CONFIG_ME_BIN_PATH="site-local/monolake/monolake_me.bin"
CONFIG_HAVE_IFD_BIN=y
CONFIG_PCIEXP_L1_SUB_STATE=y
CONFIG_CONSOLE_POST=y
CONFIG_LINUX_COMMAND_LINE="earlyprintk=ttyS0,57600n1 console=ttyS0,57600n1 loglevel=7"
CONFIG_PCIEXP_ASPM=y
CONFIG_PCIEXP_COMMON_CLOCK=y
CONFIG_PCIEXP_CLK_PM=y
CONFIG_HAVE_ME_BIN=y
CONFIG_HAVE_GBE_BIN=n
CONFIG_LOCK_MANAGEMENT_ENGINE=y
CONFIG_NO_GFX_INIT=y
CONFIG_DEBUG_TPM=n
CONFIG_CONSOLE_SERIAL_57600=y
CONFIG_PAYLOAD_LINUX=y
CONFIG_PAYLOAD_FILE="site-local/monolake/linux-uroot.bzImage"
CONFIG_DEFAULT_CONSOLE_LOGLEVEL_5=y
CONFIG_VPD_SMBIOS_VERSION=y
```

## facebook/deltalake/bin/deltalake/defconfig
```kconfig
# CONFIG_USE_BLOBS is not set
CONFIG_VENDOR_OCP=y
# CONFIG_CONSOLE_POST is not set
CONFIG_IFD_BIN_PATH="site-local/deltalake/flashregion_0_flashdescriptor.bin"
CONFIG_ME_BIN_PATH="site-local/deltalake/flashregion_2_intel_me.bin"
CONFIG_CONSOLE_CBMEM_BUFFER_SIZE=0x20000
CONFIG_HAVE_IFD_BIN=y
CONFIG_ADD_FSP_BINARIES=y
CONFIG_FSP_M_FILE="site-local/deltalake/Server_M.fd"
CONFIG_FSP_S_FILE="site-local/deltalake/Server_S.fd"
CONFIG_LINUX_COMMAND_LINE="earlyprintk=uart8250,io,0x2f8,57600n1 console=uart8250,io,0x2f8,57600n1"
CONFIG_UART_PCI_ADDR=0x0
CONFIG_CPU_MICROCODE_CBFS_EXTERNAL_BINS=y
CONFIG_CPU_UCODE_BINARIES="site-local/deltalake/mbf5065a.mcb site-local/deltalake/mbf5065b.mcb"
CONFIG_HAVE_ME_BIN=y
CONFIG_DO_NOT_TOUCH_DESCRIPTOR_REGION=y
# CONFIG_ON_DEVICE_ROM_LOAD is not set
CONFIG_SUBSYSTEM_VENDOR_ID=0x0000
CONFIG_SUBSYSTEM_DEVICE_ID=0x0000
CONFIG_DISPLAY_HOBS=y
CONFIG_DISPLAY_UPD_DATA=y
CONFIG_FSP_T_FILE="site-local/deltalake/Server_T.fd"
CONFIG_CONSOLE_SERIAL_57600=y
CONFIG_POST_IO_PORT=0x80
CONFIG_PAYLOAD_LINUX=y
CONFIG_PAYLOAD_FILE="site-local/deltalake/bzImage"
CONFIG_LINUX_INITRD="site-local/deltalake/payload.cpio.xz"
CONFIG_DISPLAY_FSP_CALLS_AND_STATUS=y
CONFIG_DISPLAY_FSP_HEADER=y
CONFIG_VERIFY_HOBS=y
CONFIG_DISPLAY_FSP_VERSION_INFO=y
```
